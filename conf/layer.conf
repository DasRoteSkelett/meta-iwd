## conf/layer.conf
```bitbake
# We have a conf and classes directory, add to BBPATH
BBPATH .= ":${LAYERDIR}"

# We have recipes-* directories, add to BBFILES
BBFILES += "${LAYERDIR}/recipes-*/*/*.bb \
            ${LAYERDIR}/recipes-*/*/*.bbappend"

BBFILE_COLLECTIONS += "meta-iwd"
BBFILE_PATTERN_meta-iwd = "^${LAYERDIR}/"
BBFILE_PRIORITY_meta-iwd = "6"

LAYERDEPENDS_meta-iwd = "core"
LAYERSERIES_COMPAT_meta-iwd = "warrior zeus"
```
